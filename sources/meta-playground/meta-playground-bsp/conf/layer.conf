## sources/meta-playground/meta-playground-os/conf/distro/playground-mini.conf
```bitbake
# Base Yocto distro
include conf/distro/poky.conf

# Name of the distro
DISTRO = "playground-mini"

# Version of the distro
DISTRO_VERSION = "1.0"

# Extra features for all images built with this distro
DISTRO_FEATURES:append = " wifi bluetooth systemd wayland"

# Enable debug and dev tools by default
EXTRA_IMAGE_FEATURES += "dbg-pkgs ssh-server-openssh package-management"

# Preferred init manager
PREFERRED_PROVIDER_virtual/init_manager = "systemd"

DISTRO_FEATURES:append = " systemd usrmerge"
VIRTUAL-RUNTIME_init_manager = "systemd"
VIRTUAL-RUNTIME_initscripts = ""


# Optional: set default locale
IMAGE_FSTYPES = "tar.bz2 ext4"
```
